## config/west.yml
```yaml
manifest:
  remotes:
    - name: zmkfirmware
      url-base:  https://github.com/0nOff
  projects:
    - name: zmk
      remote: zmkfirmware
      revision: main
      import: app/west.yml
  self:
    path: config
```
